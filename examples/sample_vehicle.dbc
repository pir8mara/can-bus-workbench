VERSION ""

NS_ :

BS_:

BU_: Vector__XXX

BO_ 291 ExampleCounter: 8 Vector__XXX
 SG_ Counter : 8|8@1+ (1,0) [0|255] "count" Vector__XXX

BO_ 1110 ExampleStatic: 8 Vector__XXX
 SG_ StaticByte : 0|8@1+ (1,0) [0|255] "raw" Vector__XXX
